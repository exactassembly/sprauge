## src/meta-sprauge/conf/layer.conf
```bitbake
# We have a conf and classes directory, add to BBPATH
BBPATH .= ":${LAYERDIR}"

# We have recipes-* directories, add to BBFILES
BBFILES += "${LAYERDIR}/recipes-*/*/*.bb \
${LAYERDIR}/recipes-*/*/*.bbappend"

BBFILE_COLLECTIONS += "meta-sprauge"
BBFILE_PATTERN_meta-sprauge = "^${LAYERDIR}/"
BBFILE_PRIORITY_meta-sprauge = "7"

LAYERVERSION_meta-sprauge = "1"
```
